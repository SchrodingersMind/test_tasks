## meta-mytestlayer/conf/layer.conf
```bitbake
# We have a conf and classes directory, add to BBPATH
BBPATH .= ":${LAYERDIR}"

# We have recipes-* directories, add to BBFILES
BBFILES += "${LAYERDIR}/recipes-*/*/*.bb \
            ${LAYERDIR}/recipes-*/*/*.bbappend"

BBFILE_COLLECTIONS += "meta-mytestlayer"
BBFILE_PATTERN_meta-mytestlayer = "^${LAYERDIR}/"
BBFILE_PRIORITY_meta-mytestlayer = "6"

LAYERDEPENDS_meta-mytestlayer = "core"
LAYERSERIES_COMPAT_meta-mytestlayer = "nanbield"
```
